## drivers/iommu/hisi/Kconfig
```kconfig
# Hisilicon IOMMU support

config HISI_IODOMAIN_API
	bool

config HISI_IOMMU
	bool "Hisilicon IOMMU Support"
	select IOMMU_API
	select HISI_IODOMAIN_API
	help
	  Hisilicon IOMMU Support.

config HISI_IOMMU_LPAE
	bool "Hisilicon IOMMU LPAE Support"
	select IOMMU_API
	depends on HISI_IOMMU
	help
	  Hisilicon IOMMU Support.
```

## drivers/power/hisi/charger/Kconfig
```kconfig
config HISI_CHARGER
	bool "hisi charger"
	default n
config SCHARGER_V200
	bool "schargerV200"
	default n
config SCHARGER_V300
	bool "schargerV300"
	default n
```

## drivers/power/hisi/coul/Kconfig
```kconfig
config HISI_COUL
        bool "hisi coul"
        default n
config HISI_COUL_HI6555V200
        bool "hisi hi6555v200 coul"
        default n
config HISI_COUL_TEST
        bool "hisi coul test"
        default n
```

## drivers/power/hisi/soh/Kconfig
```kconfig
config HISI_SOH
        bool "hisi soh"
        default n

config HISI_SOH_HI6531
        bool "hisi soh hi6531 driver"
        default n
```

## drivers/usb/dwc3/hisi/Kconfig
```kconfig
config USB_DWC3_HISI
	tristate "Hisilicon Platforms"
	default USB_DWC3
	help
	  Support of USB2/3 functionality in hisilicon platforms,
	  Say 'Y' or 'M' here if you have one such device.

if USB_DWC3_HISI

config USB_DWC3_NOV
       tristate "Hisilicon Platforms NOV USB"
       default n
       help
         Support of USB2 functionality in hisilicon platforms,
         Say 'Y' or 'M' here if you have one such device.

config USB_DWC3_OCT
       tristate "Hisilicon Platforms OCT USB"
       default n
       help
         Support of USB2 functionality in hisilicon platforms,
         Say 'Y' or 'M' here if you have one such device.

config USB_DWC3_APR
	tristate "Hisilicon Platforms APR USB"
	default n
	help
	  Support of USB2/3/3.1 functionality in hisilicon platforms,
	  Say 'Y' or 'M' here if you have one such device.

config USB_DWC3_MAR
	tristate "Hisilicon Platforms MAR USB"
	default n
	help
	  Support of USB2/3/3.1 functionality in hisilicon platforms,
	  Say 'Y' or 'M' here if you have one such device.

config USB_DWC3_FEB
	tristate "Hisilicon Platforms FEB USB"
	default n
	help
	  Support of USB2/3 functionality in hisilicon platforms,
	  Say 'Y' or 'M' here if you have one such device.

config USB_DWC3_JAN
	tristate "Hisilicon Platforms JAN USB"
	default n
	help
	  Support of USB2/3 functionality in hisilicon platforms,
	  Say 'Y' or 'M' here if you have one such device.

config USB_DWC3_VBUS_PLT
	tristate "Hisilicon Platforms USB VBUS usb platform drv intf"
	depends on HISI_PMIC
	default n
	help
	  Use platform bus register usb insert/pull-out interrupt.

config USB_DWC3_VBUS_SPMI
	tristate "Hisilicon Platforms USB VBUS usb spmi drv intf"
	depends on HISI_SPMI
	default n
	help
	  Use spmi bus register usb insert/pull-out interrupt.

endif # USB_DWC3_HISI

config USB_DWC3_OTG
	bool "Enable DWC3 OTG"
	default n
	help
	  Say Y here to enable DWC3 OTG feature.

config CONTEXTHUB_PD
	bool "Sensor CONTEXTHUB PD driver"
	default n
	help
	  Say yes here if you want to use contexthub pd function
```

## drivers/vcodec/hi_vcodec/Kconfig
```kconfig
menu "VCODEC DRIVER Configuration"

config VCODEC_PLATFORM_HIVCODECV210
        tristate "v210 Vcodec configs"
        default n

if VCODEC_PLATFORM_HIVCODECV210
source "drivers/vcodec/hi_vcodec/vdec_hivna/Kconfig"
source "drivers/vcodec/hi_vcodec/venc_hivna/drv/venc/Kconfig"
endif

endmenu
```

## fs/proc/hisi/Kconfig
```kconfig
if PROC_FS=y

menuconfig HISI_PROC
	bool "hisilicon proc support"
	depends on PROC_FS
	help
	  select hisilicon proc.

config HISI_PROC_HARDWARE
	bool "/proc/hardware support"
	depends on HISI_PROC && OF
	help
	  read the /proc/hardware to get hardware info.

config HISI_PROC_MEMORYINFO_FAST
	bool "/proc/meminfo_lite support"
	depends on HISI_PROC && OF
	default n
	help
	  offer a fast way to get system memory info(free and aviliable)

config PROCESS_RECLAIM
	bool "Enable process reclaim"
	depends on PROC_FS
	default n
	help
	 It allows to reclaim pages of the process by /proc/pid/reclaim.

	 (echo file > /proc/PID/reclaim) reclaims file-backed pages only.
	 (echo anon > /proc/PID/reclaim) reclaims anonymous pages only.
	 (echo all > /proc/PID/reclaim) reclaims all pages.

	 (echo addr size-byte > /proc/PID/reclaim) reclaims pages in
	 (addr, addr + size-bytes) of the process.

	 Any other vaule is ignored.

config HISI_SWAP_ZDATA
	bool "Compressed data to swap"
	depends on SWAP
	depends on PROCESS_RECLAIM
	default n
	help
	  Save compressed data to swap page.

	  If unsure, say Y to enable swap_zdata.

endif # PROC_FS
```

## kernel/sched/Kconfig
```kconfig
config SCHED_HISI_TOP_TASK
	bool "Maintain the top task load of each cpu"
	depends on SCHED_WALT
	default n
	help
	  Hisi schedutil governor may use the top task load as a guide to
	  frequency evaluation.

config SCHED_HISI_MIGRATE_SPREAD_LOAD
	bool "Spread task's load when inter-cluster migration"
	depends on SCHED_WALT
	default n
	help
	  In inter-cluster migration, this option will spread task's
	  prev_window/curr_window to all cpus that the task has been
	  running on before in a window. If disabled, task's whole load
	  will move to dest cpu and that will make dest cpu's cpu load
	  very high in same cases.

config SCHED_HISI_FORCE_CMP_BACKUP
	bool "Always consider backup cpu in non-preferidle case"
	depends on HISI_EAS_SCHED
	default n
	help
	  This option compares backup_cpu if target_cpu == prev_cpu.
	  In other words, for non-prefer idle tasks it may chose an idle
	  cpu even if prev_cpu is the best active cpu.
	  Not recommended because it will make all tasks spread.
```

## security/hkip_atkinfo/Kconfig
```kconfig
config HKIP_ATKINFO
	bool "Upload HKIP attack information"
	depends on HISI_HHEE
	default n
	help
	Upload the attack information reported by HKIP to Huawei server.
```

## security/hw_root_scan/Kconfig
```kconfig
#
# Copyright (c) Huawei Technologies Co., Ltd. 2016-2018. All rights reserved.
# Description: Huawei root scanner configuration
# Author:likun <quentin.lee@huawei.com>
# Create: 2016-06-18
#

menu "Huawei root scanner"

config HW_ROOT_SCAN
	tristate "enables Huawei root scanner"
	default n
	help
	  This option enables support for Huawei root scanner in kernel space.
	  Huawei root scanner will check if the device is got rooting or not
	  base on five items, kernel code integrity, system call table
	  integrity, SeLinux status, SeLinux hooks status, and root processes.

endmenu
#a blank line must be existed
```

## security/kernel_harden/Kconfig
```kconfig
#
# Huawei Kernel Harden
#

menu "Huawei Kernel Harden"

config HUAWEI_HIDESYMS
	bool "hide symbols"
	default n
	help
	Hide some sensitive kernel symbols

config HW_SLUB_SANITIZE
	bool "Sanitize Slub allocations"
	depends on SLUB
	default n
	help
         Zero fill slab allocations on free, reducing the lifetime of
         sensitive data and helping to mitigate use-after-free bugs.
         For slabs with debug poisoning enabling, this has no impact.
endmenu
#a blank line must be existed
```
