## drivers/connectivity/Kconfig
```kconfig
#
# Generic huawei hisi misc drivers configuration
#
menuconfig CONNECTIVITY_HI110X
	bool "Hisilicon Wireless Connectivity Support"
	---help---
	  If you want to use Hisilicon  Wireless Connectivity, you should set this,
	  and choose one product

if CONNECTIVITY_HI110X
config CONNECTIVITY_HI1102
	bool "Connectivity Hi1102 support"
	default y

config HI110X_GPS_REFCLK
  bool "Hisilicon 110X gps refclk feature"
  default y
  ---help---
    Hisilicon 110X gps refclk feature

config HI110X_GPS_REFCLK_INTERFACE
  bool "Hisilicon 110X gps refclk interface with hwgps"
  default n
  ---help---
    Hisilicon 110X gps refclk interface with hwgps

choice
  prompt "GPS RefClk Type"
  default HI110X_GPS_REFCLK_SRC_3
  config HI110X_GPS_REFCLK_SRC_1
    bool "modem provide gps one ref clk source, like plat A"
  config HI110X_GPS_REFCLK_SRC_2
    bool "modem provide gps two ref clk source, like plat D"
  config HI110X_GPS_REFCLK_SRC_3
    bool "modem provide gps three ref clk source, other plat"
endchoice

config HI110X_GPS_SYNC
  bool "Hisilicon 110X gps sync feature"
  default y
  ---help---
    Hisilicon 110X gps sync feature temp default n till sync feature of other module complete
endif

if CONNECTIVITY_HI1102
source "drivers/connectivity/hisi/Kconfig"
source "drivers/connectivity/hisi/platform/Kconfig"
source "drivers/connectivity/hisi/wifi/Kconfig"
endif
```

## drivers/connectivity/hi11xx/Kconfig
```kconfig
#
# Generic huawei hisi misc drivers configuration
#
source "drivers/connectivity/hi11xx/hi1102a/Kconfig"
source "drivers/connectivity/hi11xx/hi1102a/platform/Kconfig"
source "drivers/connectivity/hi11xx/hi1102a/wifi/Kconfig"
```

## drivers/contexthub/Kconfig
```kconfig
config CONTEXTHUB
	bool "Sensor CONTEXTHUB driver"
	depends on INPUTHUB || INPUTHUB_20
	default n
	help
	Sensor CONTEXTHUB driver.

config CONTEXTHUB_SHMEM
	bool "Sensor CONTEXTHUB SHMEM driver"
	depends on INPUTHUB || INPUTHUB_20
	default y
	help
	Say yes here if you want to configure contexthub share memory

config CONTEXTHUB_LOADMONITOR
	bool "Sensor CONTEXTHUB LOADMONITOR driver"
	depends on CONTEXTHUB
	default n
	help
	Say yes here if you want to use contexthub shell dbg function

source "drivers/contexthub/flp/Kconfig"
```

## drivers/cpufreq/hisi/Kconfig.arm
```kconfig
config HISI_CPUFREQ_DT
	bool "Hisilicon cpufreq-dt enable"
	depends on CPUFREQ_DT
	default n
	help
	  Hisilicon cpufreq-dt enable.

config HISI_HW_VOTE_CPU_FREQ
	bool "Hisilicon cpufreq-hw_vote enable"
	depends on HISI_CPUFREQ_DT && HISI_HW_VOTE
	default n
	help
	  Hisilicon cpufreq-hw_vote enable.

config HISI_CPUDDR_FREQ_LINK
	bool "Hisilicon cpu ddr freq link enable"
	depends on CPUFREQ_DT
	default n
	help
	  Hisilicon cpu ddr freq link enable.

config HISI_CPU_FREQ_GOV_SCHEDUTIL
	bool "Hisilicon 'schedutil' cpufreq governor optimize"
	depends on CPU_FREQ_GOV_SCHEDUTIL
	default n
	help
	  This extends the functionality of existing schedutil governor.

config HISI_CPU_FREQ_LOCK_DETECT
	bool "Hisilicon schedutil detect freq lock&unlock"
	depends on HISI_CPU_FREQ_GOV_SCHEDUTIL
	default n
	help
	  This extends min_sample_time when boost scene finish
```

## drivers/hisi/ddrc/Kconfig
```kconfig
config HISILICON_PLATFORM_DDRC
	bool "Hisilicon platform ddr controller support"
	default n
	help
	  Say yes here to support the hisilicon platform ddr controller

config HISI_DDRC_SEC
	bool "hisi ddr secprotect"
	default n

config HISI_DDR_PERF_CTRL
        tristate "Hisilicon DDR Performance Control Function"
        depends on PERF_CTRL
        default n
        help
	  Hisilicon DDR Performance Control Function
```

## drivers/hisi/emcom/Kconfig
```kconfig
menuconfig HUAWEI_EMCOM
    bool "Huawei emcom feature support"
    default n
    help
    Say yes here to support emcom feature

if HUAWEI_EMCOM
source "drivers/hisi/emcom/argo/Kconfig"
source "drivers/hisi/emcom/xengine/Kconfig"
source "drivers/hisi/emcom/smartcare/Kconfig"
source "drivers/hisi/emcom/nweval/Kconfig"
source "drivers/hisi/emcom/opmp/Kconfig"
source "drivers/hisi/emcom/nstack/Kconfig"
endif # if HUAWEI_EMCOM
```

## drivers/hisi/emcom/smartcare/Kconfig
```kconfig
menuconfig HW_NETWORK_MEASUREMENT
	bool "Huawei Network Measurement System"
	depends on HUAWEI_EMCOM
	default n

if HW_NETWORK_MEASUREMENT
source "drivers/hisi/emcom/smartcare/fi/Kconfig"
endif # if HW_NETWORK_MEASUREMENT
```

## drivers/hisi/hifi_mailbox/ipcm/Kconfig
```kconfig
menu "Hifi mailbox driver"

config HIFI_IPC
     bool "k3 multicore ipc driver"
     default n
     help
          k3 multicore ipc driver.
config HIFI_IPC_3660
     bool "hifi 3660 mailbox driver base on ipc"
     default n
     help
          transplant 3660 mailbox driver.
endmenu
```

## drivers/hisi/hwusb/Kconfig
```kconfig
source "drivers/hisi/hwusb/hw_gadget/Kconfig"
source "drivers/hisi/hwusb/hw_usb/Kconfig"
```

## drivers/hisi/ivp/Kconfig
```kconfig
menu "Hisilicon IVP"

config HISI_IVP
     bool "hisilicon ivp support"
     default n
     help
          ivp driver for ivpv100.

config IVP_SMMU
	bool "Hisilicon IVP SMMU Support"
	depends on IOMMU_API
	depends on HISI_IODOMAIN_API
	help
	  Hisilicon IVP IOMMU Support.

choice
	prompt "IVP Platform"
	default IVP_IVPV120
	depends on HISI_IVP
	help
	  select ivp platform private setting

config IVP_IVPV120
	bool "ivpv120"
	depends on HISI_IVP

endchoice
endmenu
```

## drivers/hisi/mailbox/hisi_mailbox/Kconfig
```kconfig
comment "hisi ipc MailBox driver"
config HISI_MAILBOX
	bool "hisi ipc MailBox driver"
	default n
	help
	  hisi ipc MailBox driver
	  
comment "hisi kernel API about remote processor communication"
config HISI_RPROC
	bool "hisi ipc kernel API"
	default n
	help
	  hisi kernel API about remote processor communication
```

## drivers/hisi/mailbox/ipc_mailbox/Kconfig
```kconfig
comment "hisi ipc MailBox driver"
config HISI_MAILBOX
	bool "hisi ipc MailBox driver"
	default n
	help
	  hisi ipc MailBox driver

comment "hisi kernel API about remote processor communication"
config HISI_RPROC
	bool "hisi ipc kernel API"
	default n
	help
	  hisi kernel API about remote processor communication

comment "hisi rproc kernel API debugfs"
config HISI_RPROC_TESTFILE
	bool "hisi rproc kernel API test file"
	depends on HISI_RPROC
	default n
	help
	  debug for hisi_rproc

comment "bsp_reset_core_notify to support modem compile"
config BSP_RESET_CORE_NOTIFY
	bool "bsp_reset_core_notify"
	default n
	help
	  to support modem compile
```

## drivers/hisi/memory_dump/Kconfig
```kconfig
config HISILICON_PLATFORM_KERNELDUMP
	bool "Support KERNELDUMP"
	default n
	help
	  This driver supports XXX KERNELDUMP,
	  including kerneldump driver.

config HISI_KERNELDUMP
	bool "Support KERNELDUMP"
	default n
	help
	  This driver supports KERNELDUMP,
	  including kerneldump driver.
```

## drivers/hisi/mntn/Kconfig
```kconfig
config HISILICON_PLATFORM_MAINTAIN
	bool "platform maintain module support"
	default n
	help
	  Say yes here to support the platform maintain module

source "drivers/hisi/mntn/blackbox/Kconfig"
source "drivers/hisi/mntn/hisee/Kconfig"
source "drivers/hisi/mntn/bl31/Kconfig"
source "drivers/hisi/mntn/subpmu/Kconfig"

config HISI_BOOT_TIME
	bool "support print all boot slice"
	default n
	help
	  Say 'Y' here if you want to print all boot slice.

config HISI_POWER_OFF
	bool "platform power off and reset driver"
	default n
	help
	  Power off and reset support for the boards.

config HISI_FIQ
	bool "platform fiq dump driver"
	default n
	help
	   Say 'Y' here if you want to support fiq dump.

config HISI_MNTNDUMP
        bool "platform mntn dump driver"
        default n
        help
           Say 'Y' here if you want to support mntn dump.

config HISI_DEBUG_FS
	bool "platform debugfs"
	depends on DEBUG_FS
	help
		debugfs disable by self

config HISI_RECORD_SP
        bool "platform mntn record sp"
		depends on FUNCTION_TRACER
		default n
        help
           Say 'Y' here if you want to support record sp.

config HISI_CLANG
        bool "clang compiler auxiliary for kernel"
        default n
        help
           Say 'Y' here if you want to support clang.

config HISI_EARLY_PANIC
        bool "early ap panic save log buf"
        depends on HISI_BB
        default n
        help
           Say 'Y' here if you want to use enable early log buf
```

## drivers/hisi/mntn/blackbox/Kconfig
```kconfig
menu "RDR - Running data recorder menu"

config HISI_BB
	bool "kernel run data recorder"
	depends on SYSFS
	default n
	help
	  This module can record some data about kernel internal info.
	  Include:
	  the task switch,
	  interrupts switch,
	  arm exception info,
	  etc ...

config HISI_BB_DEBUG
	bool "test unit for kernel run data recorder"
	depends on SYSFS && HISI_BB
	default n
	help
	  This module can test RDR function ...
	  Include:
	  dataabort,
	  etc

# need_other_module_clear
config HISI_LPMCU_BB
	bool "lpmcu bbox"
	depends on  HISI_BB
	default n
	help
	  This module can record some data about lpmcu info.
	  Include:
	  lpmcu exception,
	  etc

config HISI_HIFI_BB
	bool "hifi bbox"
	depends on  HISI_BB
	default n
	help
	  This module can record some data about hifi info.
	  Include:
	  hifi exception,
	  etc

# need_other_module_clear
config HISP_RDR
	bool "hisp rdr"
	depends on HISI_BB
	default n
	help
	  This module can record isp rdr info.
	  Include:
	  isp,
	  etc

config HISI_DFX_CORE
	bool "dfx core"
	depends on HISI_BB
	default n
	help
	  This module can record some data to dfx partition.
	  Include:
	  dfx,
	  etc

config HISI_MNTN_ESUBTYPE
	bool "exception subtype"
	depends on HISI_BB
	default n
	help
	  This module can record exception subtype.
	  Include:
	  exception subtype,
	  etc

source "drivers/hisi/mntn/blackbox/platform_ap/Kconfig"
source "drivers/hisi/hifi_dsp/Kconfig"
endmenu
```

## drivers/hisi/mntn/blackbox/platform_ap/Kconfig
```kconfig
config HISI_REENTRANT_EXCEPTION
	bool "reentrant exception"
	depends on HISI_BB
	default n
	help
	  this module deal with reentrant exception.

config HISI_TIME_HOOK
	bool "support print time call trace "
	depends on HISI_BB
	default n
	help
	  Say 'Y' here if you want to print time call trace.
```

## drivers/hisi/mntn/hisee/Kconfig
```kconfig
config HISEE_MNTN
    bool "hisee mntn module support"
    default n
    help
      Say yes here to support the hisee mntn module.

config HISEE_NVMFORMAT_TEST
    bool "hisee nvm format"
    default n
    help
      Say yes here to support the hisee nvm format.

config MNTN_CHECKMISC
    bool "chech misc ver"
    default n
    help
      Say yes here to support checking misc version.
```

## drivers/hisi/noc/Kconfig
```kconfig
config HISI_NOC
	depends on HISI_BB
	bool "Support NOC"
	default n
	help
	  This driver supports XXX NOC,
	  including noc driver

config HISI_NOC_DBG
	depends on HISI_NOC && HISI_DEBUG_FS
	bool "Support NOC Dbg node"
	default n
	help
	  Support NOC Dbg node
config HISI_NOC_MODID_REGISTER
	depends on HISI_NOC
	bool "Support NOC modid register"
	default n
	help
	  Support NOC modid register
```

## drivers/huawei_platform/Kconfig
```kconfig
menu "Huawei Platform Drivers"

menuconfig HUAWEI_PLATFORM
       bool "Huawei platform drivers support"
       default n
       help
       Say yes here to support the huawei platform

if HUAWEI_PLATFORM

source "drivers/huawei_platform/antenna_board_match/Kconfig"
source "drivers/huawei_platform/audio/Kconfig"
source "drivers/huawei_platform/chr/Kconfig"
source "drivers/huawei_platform/riltcp/Kconfig"
source "drivers/huawei_platform/connectivity/Kconfig"
source "drivers/huawei_platform/devdetect/Kconfig"
source "drivers/huawei_platform/iotrace/Kconfig"
source "drivers/huawei_platform/inputhub/Kconfig"
source "drivers/huawei_platform/net/Kconfig"
source "drivers/huawei_platform/nfc/Kconfig"
source "drivers/huawei_platform/power/Kconfig"
source "drivers/huawei_platform/sensor/Kconfig"
source "drivers/huawei_platform/storage/Kconfig"
source "drivers/huawei_platform/touthscreen/Kconfig"
source "drivers/huawei_platform/usb/Kconfig"
source "drivers/huawei_platform/madapt/Kconfig"
source "drivers/huawei_platform/emcom/Kconfig"
source "drivers/huawei_platform/rilsim/Kconfig"
source "drivers/huawei_platform/vendor_exception/Kconfig"
endif #HUAWEI_PLATFORM

endmenu
```

## drivers/huawei_platform/net/bastet/Kconfig
```kconfig
menu "Huawei Bastet Support"
	depends on INET && NETFILTER

config HUAWEI_BASTET
	tristate "Huawei Bastet support"
	default n
	---help---
	  This driver provides TCP sequence sync, traffic flow correction, etc. for Huawei Bastet.
endmenu
```

## drivers/huawei_platform/net/ipv4/Kconfig
```kconfig
config HW_WIFI
	bool "Huawei wifi tcp monitor support"
	default n

config HW_WIFI_MSS
    bool "Huawei WLAN MIMO SISO switch support"
    default n

config HW_WIFI_RSSI
    bool "Huawei TAS RSSI report support"
    default n

config HUAWEI_MSS_AUTO_CHANGE
        bool "Huawei MSS auto change function support"
        default n

config HW_SYN_LINEAR_RETRY
        bool "Huawei tcp syn sent linear retry support"
        default n

config HW_WIFIPRO
	bool "Huawei wifipro tcp monitor support"
	default n

config HW_WIFIPRO_PROC
	bool "Huawei wifipro proc support"
	depends on HW_WIFIPRO
	default n
```

## drivers/huawei_platform/power/Kconfig
```kconfig
source "drivers/huawei_platform/power/charger/Kconfig"
source "drivers/huawei_platform/power/hw_kstate/Kconfig"
source "drivers/huawei_platform/power/smpl/Kconfig"
source "drivers/huawei_platform/power/usb_short_circuit_protect/Kconfig"
source "drivers/huawei_platform/power/pid_socket/Kconfig"
source "drivers/huawei_platform/power/wifi_filter/Kconfig"
source "drivers/huawei_platform/power/power_thermalzone/Kconfig"
source "drivers/huawei_platform/power/hardware_monitor/Kconfig"
```

## drivers/huawei_platform/power/charger/charger_ap/Kconfig
```kconfig
source "drivers/huawei_platform/power/charger/charger_ap/direct_charger/Kconfig"
source "drivers/huawei_platform/power/charger/charger_ap/wired_channel_switch/Kconfig"
source "drivers/huawei_platform/power/charger/charger_ap/vbus_channel/Kconfig"

config HUAWEI_CHARGER_AP
	bool "huawei charger ap"
	default n
config BQ2560X_CHARGER
	bool "bq2560x charger"
	default n
config RT9466_CHARGER
	bool "rt9466 charger"
	default n
config HL7019_CHARGER
	bool "hl7019 charger"
	default n
	help
	  Say Y here to enable support for batteries with hl7019 chip.
config RT9471_CHARGER
	bool "rt9471 charger"
	default n
	help
	  Say Y here to enable support for batteries with rt9471 chip.
config DIRECT_CHARGER
	bool "direct charger"
	default n
config WIRELESS_CHARGER
	bool "wireless charger"
	default n
```

## drivers/huawei_platform/touthscreen/panel/Kconfig
```kconfig
#
# huawei touchscreen driver configuration
#

config SYNAPTICS_TS
	bool "synaptics touchscreen"
	default n
	help
	  If you say yes here you get support for synaptics touchscreen.

config ATMEL_TS
	bool "atmel touchscreen"
	default n
	help
	  If you say yes here you get support for atmel touchscreen.

menuconfig ST_TS
	bool "st touchscreen"
	default n
	help
	  If you say yes here you get support for st touchscreen.
```

## drivers/hwnet/Kconfig
```kconfig
source "drivers/hisi/hwnet/ipv4/Kconfig"
source "drivers/hisi/hwnet/booster/Kconfig"
source "drivers/hisi/hwnet/chr/Kconfig"
source "drivers/hisi/hwnet/hw_dpi_mark/Kconfig"
source "drivers/hisi/hwnet/hw_dual_connection/Kconfig"
source "drivers/hisi/hwnet/waudio/Kconfig"
```
