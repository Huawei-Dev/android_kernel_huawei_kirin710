## drivers/hisi/Kconfig
```kconfig
menu "Hisilicon platform"

menuconfig HISILICON_PLATFORM
	bool "Hisilicon platform support"
	default n
	help
	  Say yes here to support the hisilicon platform

if HISILICON_PLATFORM

source "drivers/hisi/adc/Kconfig"
source "drivers/hisi/cmdline/Kconfig"
source "drivers/hisi/mailbox/Kconfig"
source "drivers/hisi/mntn/Kconfig"
source "drivers/hisi/noc/Kconfig"
source "drivers/hisi/hisi_syscounter/Kconfig"
source "drivers/hisi/soundtrigger/Kconfig"
source "drivers/hisi/memory_dump/Kconfig"
source "drivers/hisi/drmdriver/Kconfig"
source "drivers/hisi/efuse/Kconfig"
source "drivers/hisi/hi6xxx/Kconfig"
source "drivers/hisi/hi64xx/Kconfig"
source "drivers/hisi/hi64xx_dsp/Kconfig"
source "drivers/hisi/slimbus/Kconfig"
source "drivers/hisi/hifi_dsp/Kconfig"
source "drivers/hisi/hifi_mailbox/Kconfig"
source "drivers/hisi/ddrc/Kconfig"
source "drivers/hisi/hisi_cma/Kconfig"
source "drivers/hisi/tzdriver/Kconfig"
source "drivers/hisi/hisee/Kconfig"
source "drivers/hisi/load_image/Kconfig"
source "drivers/hisi/perfhub/Kconfig"
source "drivers/hisi/l3cache/Kconfig"
source "drivers/hisi/pm/Kconfig"
source "drivers/hisi/hw_vote/Kconfig"
source "drivers/hisi/gpufreq/Kconfig"
source "drivers/hisi/modem/Kconfig"
source "drivers/hisi/ivp/Kconfig"
source "drivers/hisi/timekeeper/Kconfig"
source "drivers/hisi/test_spinlock/Kconfig"
source "drivers/hisi/hhee/Kconfig"
source "drivers/hisi/dieid/Kconfig"
source "drivers/hisi/kernel_harden_test/Kconfig"
source "drivers/hisi/secs_power_ctrl/Kconfig"
source "drivers/hisi/isp/Kconfig"
source "drivers/hisi/perf_ctrl/Kconfig"
source "drivers/hisi/rpmb/Kconfig"
source "drivers/hisi/modem/Kconfig"
source "drivers/hisi/ivp/Kconfig"
source "drivers/hisi/timekeeper/Kconfig"
source "drivers/hisi/perfhub/Kconfig"
source "drivers/hisi/cci_extra/Kconfig"

endif #HISILICON_PLATFORM

endmenu
```

## drivers/huawei_platform/net/Kconfig
```kconfig
source "drivers/huawei_platform/net/ipv4/Kconfig"
source "drivers/huawei_platform/net/bastet/Kconfig"
```

## drivers/hwnet/ipv4/Kconfig
```kconfig
config HW_WIFIPRO
	bool "Huawei wifipro tcp monitor support"
	default n

config HW_WIFIPRO_PROC
	bool "Huawei wifipro proc support"
	depends on HW_WIFIPRO
	default n

config HW_CHR_TCP_SMALL_WIN_PROC
	bool "Huawei tcp small window monitor proc support"
	depends on HW_CHR_TCP_SMALL_WIN_MONITOR
	default n
```

## mm/hisi/Kconfig
```kconfig
menuconfig HISI_MM
	bool "Hisilicon MM support"
	---help---
	  This option add some hisilicon mm codes, needed by following modules.

if HISI_MM

config HISI_PAGE_TRACE
	bool "HISI page trace"
	---help---
	  This option enables hisi page trace, needed by memleak check modules.

config HISI_PAGE_TRACE_TEST
	bool "HISI page trace test"
	depends on HISI_PAGE_TRACE
	---help---
	  This option enables hisi page trace test, needed by hisi page trace modules.

config HISI_MEM_OFFLINE
	bool "Dynamic Memory Region Offline driver"
	depends on MEMORY_HOTPLUG
	help
	  Add support for DDR Self-Refresh power management through the dynamic
	  memory offline framework. This driver interfaces between the memory
	  hotplug subsystem and AOP which hot adds or removes memory blocks and
	  controls the start/stop of self-refresh of these DDR regions. This
	  helps reduce power consumption during idle mode of the system.
	  If unsure, say N

config PM_PEAK
	bool "Physical Memory Peak"
	default n
	---help---
	  Record physical memory peak for each task.

config KSWAPD_DEBUG
	bool "kswapd debug"
	default n
	---help---
	  Provide extra log to find why kswapd is running frequently.

config REFAULT_IO_VMSCAN
	bool "Refault io vmscan"
	default n
	---help---
	  This is a new vmscan algorithm to balance anon and file lru reclaim ratio by
	  detect file and anon refault cost. This can more effectivity reclaim memory and
	  decrease totoal refault count and maybe decrease system cost.
```
